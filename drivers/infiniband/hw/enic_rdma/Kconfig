## drivers/infiniband/hw/enic_rdma/Kconfig
```kconfig
config ENIC_RDMA
	tristate "enic rdma driver"
	depends on ENIC
	---help---
	  enic_rdma interface
```

## drivers/net/ethernet/cisco/enic/Kconfig
```kconfig
#
# Cisco device configuration
#

config ENIC
	tristate "Cisco VIC Ethernet NIC Support"
	depends on PCI
	select PTP_1588_CLOCK
	---help---
	  This enables the support for the Cisco VIC Ethernet card.
```

## drivers/staging/enic_kprobe/Kconfig
```kconfig
config ENIC_KPROBE
	tristate "Kprobe driver for enic"
	depends on ENIC
	---help---
	  Kprobe driver for enic
```
